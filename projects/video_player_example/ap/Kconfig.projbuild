## projects/video_player_example/ap/Kconfig.projbuild
```kconfig
menu "LVGL Widgets Configuration"

    config LV_USE_DEMO_WIDGETS
        bool "LVGL Widgets"
        default n
endmenu

menu "INTEGRATION_DOORBELL"

    config INTEGRATION_DOORBELL
        depends on VOICE_SERVICE && VOICE_READ_SERVICE && VOICE_WRITE_SERVICE
        bool "Doorbell integration"
        default n
    config INTEGRATION_DOORVIEWER
        depends on VOICE_SERVICE && VOICE_READ_SERVICE && VOICE_WRITE_SERVICE
        bool "Doorviewer integration"
        default n
    config INTEGRATION_DOORBELL_CS2
        depends on INTEGRATION_DOORBELL || INTEGRATION_DOORVIEWER
        bool "Doorbell integration CS2"
        default n
endmenu
```
